## server/tests/Kconfig
```kconfig
menu "Server Tests"

config DRIVER_INTERFACE_TESTS
  bool "Build driver interface tests"
  default n
  depends on BUILD_TESTS

config SERVER_FRAMEWORK_TESTS
  bool "Build server framework tests"
  default n
  depends on BUILD_TESTS && FRAMEWORK_COMMON && FRAMEWORK_AUDIO && RPC

endmenu
```

## src/arch/host/configs/a2_linux_defconfig
```kconfig
# Audio Studio A2 Linux defconfig
CONFIG_AUDIO_STUDIO_PLATFORM_A2=y
CONFIG_AUDIO_STUDIO_TARGET_OS="linux"
CONFIG_AUDIO_STUDIO_BUILD_GUI_BACKEND=y
CONFIG_AUDIO_STUDIO_BUILD_SERVER=y
CONFIG_AUDIO_STUDIO_BUILD_CLI=y
CONFIG_AUDIO_STUDIO_BUILD_AUDIO_CONTROLLER=y
```

## src/arch/host/configs/simulator_linux_defconfig
```kconfig
# Audio Studio simulator Linux defconfig
CONFIG_AUDIO_STUDIO_PLATFORM_SIMULATOR=y
CONFIG_AUDIO_STUDIO_TARGET_OS="linux"
CONFIG_AUDIO_STUDIO_BUILD_GUI_BACKEND=y
CONFIG_AUDIO_STUDIO_BUILD_SERVER=y
CONFIG_AUDIO_STUDIO_BUILD_CLI=y
CONFIG_AUDIO_STUDIO_BUILD_AUDIO_CONTROLLER=y
```
