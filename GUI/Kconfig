## Kconfig
```kconfig
mainmenu "Audio Studio"

config AUDIO_STUDIO
  bool "Audio Studio build"
  default y

source "GUI/Kconfig"
source "tests/Kconfig"
source "drivers/Kconfig"
source "rpc/Kconfig"
source "server/Kconfig"
source "cli/Kconfig"
```

## cli/Kconfig
```kconfig
menu "CLI"

config CLI
  bool "Build CLI tools"
  default n
  depends on SERVER

endmenu
```

## configs/a2_linux_defconfig
```kconfig
# Audio Studio M0 A2 Linux profile
CONFIG_AUDIO_STUDIO_PLATFORM_A2=y
CONFIG_AUDIO_STUDIO_BUILD_GUI_BACKEND=y
CONFIG_AUDIO_STUDIO_BUILD_SERVER=y
CONFIG_AUDIO_STUDIO_BUILD_CLI=y
CONFIG_AUDIO_STUDIO_BUILD_AUDIO_CONTROLLER=y
```

## configs/host_linux_defconfig
```kconfig
CONFIG_AUDIO_STUDIO=y
CONFIG_TARGET_OS_LINUX=y
CONFIG_TOOLCHAIN_GCC=y
CONFIG_GUI_BACKEND=y
CONFIG_BUILD_TESTS=y
CONFIG_SERVER=n
CONFIG_CLI=n
CONFIG_FRAMEWORK_COMMON=n
CONFIG_DRIVER_DUMMY=n
```

## configs/macos_clang_defconfig
```kconfig
CONFIG_AUDIO_STUDIO=y
CONFIG_TARGET_OS_MACOS=y
CONFIG_TOOLCHAIN_OSXCROSS=y
CONFIG_GUI_BACKEND=n
CONFIG_BUILD_TESTS=y
CONFIG_SERVER=y
CONFIG_CLI=y
CONFIG_FRAMEWORK_COMMON=y
CONFIG_DRIVER_DUMMY=y
```

## configs/profile/as_server_minimal_defconfig
```kconfig
CONFIG_AUDIO_STUDIO=y
CONFIG_GUI_BACKEND=n
CONFIG_BUILD_TESTS=n
CONFIG_SERVER=y
CONFIG_RPC=n
CONFIG_CLI=n
```

## configs/profile/driver_interface_tests_defconfig
```kconfig
CONFIG_AUDIO_STUDIO=y
CONFIG_GUI_BACKEND=n
CONFIG_BUILD_TESTS=y
CONFIG_DRIVER_INTERFACE_TESTS=y
CONFIG_SERVER_FRAMEWORK_TESTS=y
CONFIG_SERVER=y
CONFIG_RPC=y
CONFIG_RPC_CORE=y
CONFIG_RPC_CLIENT=y
CONFIG_RPC_SERVER=y
CONFIG_RPC_AUDIO_METHODS=y
CONFIG_RPC_TRANSPORT_SOCKET=y
CONFIG_RPC_TRANSPORT_PIPE=y
CONFIG_CLI=n
CONFIG_FRAMEWORK_COMMON=y
CONFIG_FRAMEWORK_AUDIO=y
CONFIG_FRAMEWORK_CONFIG=y
CONFIG_FRAMEWORK_LOG=y
CONFIG_FRAMEWORK_TRANSPORT=y
CONFIG_PLATFORM_CORE=y
CONFIG_DRIVERS_CORE=y
CONFIG_DRIVER_OS=y
CONFIG_DRIVER_OS_LINUX_HOST=y
CONFIG_DRIVER_SOCKET=y
CONFIG_DRIVER_SOCKET_LINUX_HOST=y
CONFIG_DRIVER_FILESYSTEM=y
CONFIG_DRIVER_FILESYSTEM_LINUX_HOST=y
CONFIG_DRIVER_PIPE=y
CONFIG_DRIVER_PIPE_LINUX_HOST=y
CONFIG_DRIVER_DYNLIB=y
CONFIG_DRIVER_DYNLIB_LINUX_HOST=y
CONFIG_DRIVER_DATALINK=y
CONFIG_DRIVER_DATALINK_LINUX_HOST=y
CONFIG_DRIVER_AUDIO=y
CONFIG_DRIVER_AUDIO_ALSA=y
CONFIG_DRIVER_AUDIO_PULSE=y
CONFIG_DRIVER_CONTROL=y
CONFIG_DRIVER_CONTROL_LINUX_HOST=y
CONFIG_DRIVER_LOG=y
CONFIG_DRIVER_LOG_LINUX_HOST=y
CONFIG_DRIVER_DUMP=y
CONFIG_DRIVER_DUMP_LINUX_HOST=y
```

## configs/profile/driver_interface_tests_macos_defconfig
```kconfig
CONFIG_AUDIO_STUDIO=y
CONFIG_GUI_BACKEND=n
CONFIG_BUILD_TESTS=y
CONFIG_DRIVER_INTERFACE_TESTS=y
CONFIG_SERVER_FRAMEWORK_TESTS=y
CONFIG_SERVER=y
CONFIG_RPC=y
CONFIG_RPC_CORE=y
CONFIG_RPC_CLIENT=y
CONFIG_RPC_SERVER=y
CONFIG_RPC_AUDIO_METHODS=y
CONFIG_RPC_TRANSPORT_SOCKET=y
CONFIG_RPC_TRANSPORT_PIPE=y
CONFIG_CLI=n
CONFIG_FRAMEWORK_COMMON=y
CONFIG_FRAMEWORK_AUDIO=y
CONFIG_FRAMEWORK_CONFIG=y
CONFIG_DRIVERS_CORE=y
CONFIG_DRIVER_OS=y
CONFIG_DRIVER_OS_MACOS=y
CONFIG_DRIVER_SOCKET=y
CONFIG_DRIVER_SOCKET_MACOS=y
CONFIG_DRIVER_FILESYSTEM=y
CONFIG_DRIVER_FILESYSTEM_MACOS=y
CONFIG_DRIVER_PIPE=y
CONFIG_DRIVER_PIPE_MACOS=y
CONFIG_DRIVER_DYNLIB=y
CONFIG_DRIVER_DYNLIB_MACOS=y
CONFIG_DRIVER_DATALINK=y
CONFIG_DRIVER_DATALINK_MACOS=y
CONFIG_DRIVER_AUDIO=y
CONFIG_DRIVER_AUDIO_MACOS=y
CONFIG_DRIVER_CONTROL=y
CONFIG_DRIVER_CONTROL_MACOS=y
CONFIG_DRIVER_LOG=y
CONFIG_DRIVER_LOG_MACOS=y
CONFIG_DRIVER_DUMP=y
CONFIG_DRIVER_DUMP_MACOS=y
```

## configs/profile/gui_backend_defconfig
```kconfig
CONFIG_AUDIO_STUDIO=y
CONFIG_GUI_BACKEND=y
CONFIG_BUILD_TESTS=y
CONFIG_SERVER=n
CONFIG_RPC=y
CONFIG_RPC_CORE=y
CONFIG_RPC_CLIENT=y
CONFIG_RPC_SERVER=n
CONFIG_RPC_AUDIO_METHODS=n
CONFIG_RPC_TRANSPORT_SOCKET=y
CONFIG_RPC_TRANSPORT_PIPE=n
CONFIG_FRAMEWORK_COMMON=y
CONFIG_DRIVERS_CORE=y
CONFIG_DRIVER_SOCKET=y
CONFIG_DRIVER_SOCKET_LINUX_HOST=y
CONFIG_CLI=n
```

## configs/profile/rpc_pipe_defconfig
```kconfig
CONFIG_AUDIO_STUDIO=y
CONFIG_GUI_BACKEND=n
CONFIG_BUILD_TESTS=y
CONFIG_SERVER=y
CONFIG_CLI=y
CONFIG_RPC=y
CONFIG_RPC_CORE=y
CONFIG_RPC_CLIENT=y
CONFIG_RPC_SERVER=y
CONFIG_RPC_AUDIO_METHODS=y
CONFIG_RPC_TRANSPORT_SOCKET=n
CONFIG_RPC_TRANSPORT_PIPE=y
CONFIG_FRAMEWORK_COMMON=y
CONFIG_FRAMEWORK_AUDIO=y
CONFIG_FRAMEWORK_CONFIG=y
CONFIG_DRIVERS_CORE=y
CONFIG_DRIVER_DUMMY=y
CONFIG_DRIVER_OS=y
CONFIG_DRIVER_OS_LINUX_HOST=y
CONFIG_DRIVER_PIPE=y
CONFIG_DRIVER_PIPE_LINUX_HOST=y
CONFIG_DRIVER_FILESYSTEM=y
CONFIG_DRIVER_FILESYSTEM_LINUX_HOST=y
CONFIG_DRIVER_DYNLIB=y
CONFIG_DRIVER_DYNLIB_LINUX_HOST=y
CONFIG_DRIVER_AUDIO=y
CONFIG_DRIVER_AUDIO_ALSA=y
CONFIG_DRIVER_AUDIO_PULSE=y
```

## configs/profile/rpc_socket_defconfig
```kconfig
CONFIG_AUDIO_STUDIO=y
CONFIG_GUI_BACKEND=n
CONFIG_BUILD_TESTS=y
CONFIG_SERVER=y
CONFIG_CLI=y
CONFIG_RPC=y
CONFIG_RPC_CORE=y
CONFIG_RPC_CLIENT=y
CONFIG_RPC_SERVER=y
CONFIG_RPC_AUDIO_METHODS=y
CONFIG_RPC_TRANSPORT_SOCKET=y
CONFIG_RPC_TRANSPORT_PIPE=n
CONFIG_FRAMEWORK_COMMON=y
CONFIG_FRAMEWORK_AUDIO=y
CONFIG_DRIVERS_CORE=y
CONFIG_DRIVER_DUMMY=y
CONFIG_DRIVER_SOCKET=y
CONFIG_DRIVER_SOCKET_LINUX_HOST=y
```

## configs/windows_mingw_defconfig
```kconfig
CONFIG_AUDIO_STUDIO=y
CONFIG_TARGET_OS_WINDOWS=y
CONFIG_TOOLCHAIN_MINGW=y
CONFIG_GUI_BACKEND=n
CONFIG_BUILD_TESTS=y
CONFIG_SERVER=y
CONFIG_CLI=y
CONFIG_FRAMEWORK_COMMON=y
CONFIG_DRIVER_DUMMY=y
```

## drivers/Kconfig
```kconfig
menu "Drivers"

config DRIVERS_CORE
  bool "Build driver manager core"
  default n
  depends on (SERVER || GUI_BACKEND) && FRAMEWORK_COMMON

source "drivers/os/Kconfig"
source "drivers/socket/Kconfig"
source "drivers/filesystem/Kconfig"
source "drivers/pipe/Kconfig"
source "drivers/dynlib/Kconfig"
source "drivers/datalink/Kconfig"
source "drivers/audio/Kconfig"
source "drivers/control/Kconfig"
source "drivers/log/Kconfig"
source "drivers/dump/Kconfig"
source "drivers/dummy/Kconfig"

endmenu
```

## drivers/audio/Kconfig
```kconfig
menu "Audio Driver"

config DRIVER_AUDIO
  bool "Build audio driver interface"
  default n
  depends on DRIVERS_CORE

config DRIVER_AUDIO_ALSA
  bool "Build ALSA audio driver implementation"
  default n
  depends on DRIVER_AUDIO

config DRIVER_AUDIO_PULSE
  bool "Build PulseAudio audio driver implementation"
  default n
  depends on DRIVER_AUDIO

config DRIVER_AUDIO_WASAPI
  bool "Build Windows WASAPI audio driver implementation"
  default n
  depends on DRIVER_AUDIO

config DRIVER_AUDIO_MACOS
  bool "Build macOS audio driver implementation"
  default n
  depends on DRIVER_AUDIO

endmenu
```

## drivers/control/Kconfig
```kconfig
menu "Control Driver"

config DRIVER_CONTROL
  bool "Build control driver interface"
  default n
  depends on DRIVERS_CORE

config DRIVER_CONTROL_LINUX_HOST
  bool "Build Linux host control driver implementation"
  default n
  depends on DRIVER_CONTROL

config DRIVER_CONTROL_MACOS
  bool "Build macOS control driver implementation"
  default n
  depends on DRIVER_CONTROL

endmenu
```

## drivers/datalink/Kconfig
```kconfig
menu "Data-Link Driver"

config DRIVER_DATALINK
  bool "Build data-link device interface"
  default n
  depends on DRIVERS_CORE

config DRIVER_DATALINK_LINUX_HOST
  bool "Build Linux host data-link device implementation"
  default n
  depends on DRIVER_DATALINK

config DRIVER_DATALINK_MACOS
  bool "Build macOS data-link device implementation"
  default n
  depends on DRIVER_DATALINK

endmenu
```

## drivers/dummy/Kconfig
```kconfig
menu "Dummy Driver"

config DRIVER_DUMMY
  bool "Build host-alone dummy driver"
  default n
  depends on SERVER

endmenu
```

## drivers/dump/Kconfig
```kconfig
menu "Dump Driver"

config DRIVER_DUMP
  bool "Build dump driver interface"
  default n
  depends on DRIVERS_CORE

config DRIVER_DUMP_LINUX_HOST
  bool "Build Linux host dump driver implementation"
  default n
  depends on DRIVER_DUMP

endmenu
```

## drivers/filesystem/Kconfig
```kconfig
menu "Filesystem Driver"

config DRIVER_FILESYSTEM
  bool "Build filesystem driver interface"
  default n
  depends on DRIVERS_CORE

config DRIVER_FILESYSTEM_LINUX_HOST
  bool "Build Linux host filesystem driver implementation"
  default n
  depends on DRIVER_FILESYSTEM

endmenu
```

## drivers/log/Kconfig
```kconfig
menu "Log Driver"

config DRIVER_LOG
  bool "Build log driver interface"
  default n
  depends on DRIVERS_CORE

config DRIVER_LOG_LINUX_HOST
  bool "Build Linux host log driver implementation"
  default n
  depends on DRIVER_LOG

config DRIVER_LOG_MACOS
  bool "Build macOS log driver implementation"
  default n
  depends on DRIVER_LOG

endmenu
```

## drivers/os/Kconfig
```kconfig
menu "OS Driver"

config DRIVER_OS
  bool "Build OS driver interface"
  default n
  depends on DRIVERS_CORE

config DRIVER_OS_LINUX_HOST
  bool "Build Linux host OS driver implementation"
  default n
  depends on DRIVER_OS

config DRIVER_OS_MACOS
  bool "Build macOS OS driver implementation"
  default n
  depends on DRIVER_OS

endmenu
```

## drivers/pipe/Kconfig
```kconfig
menu "Pipe Driver"

config DRIVER_PIPE
  bool "Build pipe driver interface"
  default n
  depends on DRIVERS_CORE

config DRIVER_PIPE_LINUX_HOST
  bool "Build Linux host pipe driver implementation"
  default n
  depends on DRIVER_PIPE

config DRIVER_PIPE_MACOS
  bool "Build macOS pipe driver implementation"
  default n
  depends on DRIVER_PIPE

endmenu
```
