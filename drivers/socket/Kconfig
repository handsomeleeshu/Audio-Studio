## drivers/socket/Kconfig
```kconfig
menu "Socket Driver"

config DRIVER_SOCKET
  bool "Build socket driver interface"
  default n
  depends on DRIVERS_CORE

config DRIVER_SOCKET_LINUX_HOST
  bool "Build Linux host socket driver implementation"
  default n
  depends on DRIVER_SOCKET

config DRIVER_SOCKET_WINDOWS_HOST
  bool "Build Windows host socket driver implementation"
  default n
  depends on DRIVER_SOCKET

config DRIVER_SOCKET_MACOS
  bool "Build macOS socket driver implementation"
  default n
  depends on DRIVER_SOCKET

endmenu
```

## drivers/transport/Kconfig
```kconfig
menu "Transport Driver"

config DRIVER_TRANSPORT
  bool "Build transport driver interface"
  default n
  depends on DRIVERS_CORE

config DRIVER_TRANSPORT_LINUX_HOST
  bool "Build Linux host transport driver implementation"
  default n
  depends on DRIVER_TRANSPORT

config DRIVER_TRANSPORT_MACOS
  bool "Build macOS transport driver implementation"
  default n
  depends on DRIVER_TRANSPORT

endmenu
```

## platform/a2_linux/Kconfig
```kconfig
config PLATFORM_A2_LINUX
	bool
	default y if PLATFORM = "a2_linux"

config PLATFORM_A2_LINUX_TOOLCHAIN
	string
	default "platform/a2_linux/toolchain.cmake" if PLATFORM_A2_LINUX
```

## platform/simulator_linux/Kconfig
```kconfig
config PLATFORM_SIMULATOR_LINUX
	bool
	default y if PLATFORM = "simulator_linux"

config PLATFORM_SIMULATOR_LINUX_TOOLCHAIN
	string
	default "platform/simulator_linux/toolchain.cmake" if PLATFORM_SIMULATOR_LINUX
```

## rpc/Kconfig
```kconfig
menu "RPC"

config RPC
  bool "Build Audio Studio RPC support"
  default n

config RPC_CORE
  bool "Build JSON-RPC core"
  default y
  depends on RPC

config RPC_CLIENT
  bool "Build RPC client transports"
  default n
  depends on RPC_CORE

config RPC_SERVER
  bool "Build RPC server transports"
  default n
  depends on RPC_CORE && SERVER && FRAMEWORK_COMMON

config RPC_AUDIO_METHODS
  bool "Build audio RPC method bindings"
  default n
  depends on RPC_CORE && FRAMEWORK_AUDIO

config RPC_TRANSPORT_SOCKET
  bool "Enable socket RPC transport"
  default n
  depends on RPC && DRIVER_SOCKET && DRIVERS_CORE

config RPC_TRANSPORT_PIPE
  bool "Enable pipe RPC transport"
  default n
  depends on RPC && DRIVER_PIPE && DRIVERS_CORE

endmenu
```

## server/Kconfig
```kconfig
menu "Server"

config SERVER
  bool "Build as_server"
  default n

source "server/framework/Kconfig"
source "server/platform/Kconfig"
source "server/tests/Kconfig"

endmenu
```

## server/drivers/Kconfig
```kconfig
menu "Drivers"

config DRIVERS_CORE
  bool "Build driver manager core"
  default n
  depends on SERVER && FRAMEWORK_COMMON

source "server/drivers/os/Kconfig"
source "server/drivers/socket/Kconfig"
source "server/drivers/filesystem/Kconfig"
source "server/drivers/pipe/Kconfig"
source "server/drivers/dynlib/Kconfig"
source "server/drivers/transport/Kconfig"
source "server/drivers/audio/Kconfig"
source "server/drivers/control/Kconfig"
source "server/drivers/log/Kconfig"
source "server/drivers/dump/Kconfig"
source "server/drivers/dummy/Kconfig"

endmenu
```

## server/drivers/audio/Kconfig
```kconfig
menu "Audio Driver"

config DRIVER_AUDIO
  bool "Build audio driver interface"
  default n
  depends on DRIVERS_CORE

config DRIVER_AUDIO_LINUX_HOST
  bool "Build Linux host audio driver implementation"
  default n
  depends on DRIVER_AUDIO

endmenu
```

## server/drivers/dynlib/Kconfig
```kconfig
menu "Dynamic Library Driver"

config DRIVER_DYNLIB
  bool "Build dynamic library driver interface"
  default n
  depends on DRIVERS_CORE

config DRIVER_DYNLIB_LINUX_HOST
  bool "Build Linux host dynamic library driver implementation"
  default n
  depends on DRIVER_DYNLIB

endmenu
```

## server/framework/Kconfig
```kconfig
menu "Framework"

source "server/framework/common/Kconfig"
source "server/framework/session/Kconfig"
source "server/framework/control/Kconfig"
source "server/framework/audio/Kconfig"
source "server/framework/config/Kconfig"
source "server/framework/log/Kconfig"
source "server/framework/dump/Kconfig"
source "server/framework/plugin/Kconfig"
source "server/framework/transport/Kconfig"

endmenu
```

## server/framework/audio/Kconfig
```kconfig
config FRAMEWORK_AUDIO
  bool "Build audio framework library"
  default n
  depends on FRAMEWORK_COMMON
```

## server/framework/config/Kconfig
```kconfig
config FRAMEWORK_CONFIG
  bool "Build config compiler framework library"
  default n
  depends on FRAMEWORK_COMMON && DRIVER_FILESYSTEM && DRIVER_OS && DRIVER_DYNLIB
```

## server/framework/control/Kconfig
```kconfig
config FRAMEWORK_CONTROL
  bool "Build control framework library"
  default n
  depends on FRAMEWORK_COMMON
```

## server/framework/dump/Kconfig
```kconfig
config FRAMEWORK_DUMP
  bool "Build dump framework library"
  default n
  depends on FRAMEWORK_COMMON
```

## server/framework/log/Kconfig
```kconfig
config FRAMEWORK_LOG
  bool "Build log framework library"
  default n
  depends on FRAMEWORK_COMMON
```

## server/framework/plugin/Kconfig
```kconfig
config FRAMEWORK_PLUGIN
  bool "Build plugin framework library"
  default n
  depends on FRAMEWORK_COMMON
```

## server/framework/session/Kconfig
```kconfig
config FRAMEWORK_SESSION
  bool "Build session framework library"
  default n
  depends on FRAMEWORK_COMMON
```

## server/framework/system_info/Kconfig
```kconfig
config FRAMEWORK_SYSTEM_INFO
  bool "Build System Info framework service"
  default y if FRAMEWORK_LOG
  depends on FRAMEWORK_COMMON && FRAMEWORK_LOG
```

## server/framework/transport/Kconfig
```kconfig
config FRAMEWORK_TRANSPORT
  bool "Build transport framework library"
  default n
  depends on FRAMEWORK_COMMON
```

## server/platform/Kconfig
```kconfig
menu "Platform"

choice TARGET_PLATFORM
  prompt "Audio target chip/platform profile"
  default TARGET_PLATFORM_A2

config TARGET_PLATFORM_A2
  bool "A2"

config TARGET_PLATFORM_SIMULATOR
  bool "Simulator"

endchoice

source "server/platform/core/Kconfig"
source "server/platform/a2/Kconfig"
source "server/platform/simulator/Kconfig"

endmenu
```

## server/platform/a2/Kconfig
```kconfig
config PLATFORM_A2
  bool "Build A2 platform implementation"
  default y if TARGET_PLATFORM_A2 && PLATFORM_CORE
  depends on TARGET_PLATFORM_A2 && PLATFORM_CORE
```

## server/platform/core/Kconfig
```kconfig
config PLATFORM_CORE
  bool "Build platform registry core"
  default n
  depends on SERVER && FRAMEWORK_COMMON
```

## server/platform/simulator/Kconfig
```kconfig
config PLATFORM_SIMULATOR
  bool "Build simulator platform implementation"
  default y if TARGET_PLATFORM_SIMULATOR && PLATFORM_CORE
  depends on TARGET_PLATFORM_SIMULATOR && PLATFORM_CORE
  depends on DRIVER_DATALINK && DRIVER_LOG && FRAMEWORK_TRANSPORT
```
